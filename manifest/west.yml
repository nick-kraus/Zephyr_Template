## manifest/west.yml
```yaml
manifest:
  defaults:
    remote: zephyrproject-rtos

  remotes:
    - name: zephyrproject-rtos
      url-base: https://github.com/zephyrproject-rtos

  projects:
    - name: zephyr
      revision: v4.1.0
      clone-depth: 1
      import:
        # Only clone modules that are required by the application.
        name-allowlist:
          - cmsis
          - hal_stm32
          - mbedtls
          - mcuboot
          - segger
```
