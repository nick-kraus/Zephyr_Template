## CMakeLists.txt
```
cmake_minimum_required(VERSION 3.20.0)

# Always generate compilation database.
set(CMAKE_EXPORT_COMPILE_COMMANDS ON CACHE INTERNAL "")

# TEMPLATE_CONFIG: Set project name, used for firmware output filename.
set(PROJECT_NAME app)

# Add board name (with any slashes replaced) to firmware output filename.
string(REGEX REPLACE "[/\\\\]" "_" KERNEL_BIN_NAME \"${PROJECT_NAME}-${BOARD}\")
set(CONFIG_KERNEL_BIN_NAME ${KERNEL_BIN_NAME} CACHE STRING "build output filename" FORCE)
# Add binary descriptors 'APP_VERSION_STRING' (based off 'VERSION' file) and 'APP_BUILD_VERSION'
# (based off 'git describe'). See 'zephyr/doc/services/binary_descriptors/index.rst' for
# additional information.
set(CONFIG_BINDESC "y" CACHE STRING "use binary descriptors")
set(CONFIG_BINDESC_DEFINE "y" CACHE STRING "define binary descriptors")
set(CONFIG_BINDESC_DEFINE_VERSION "y" CACHE STRING "define version binary descriptors")
set(CONFIG_BINDESC_APP_VERSION_STRING "y" CACHE STRING "version file string binary descriptor")
set(CONFIG_BINDESC_APP_BUILD_VERSION "y" CACHE STRING "git describe string binary descriptor")

find_package(Zephyr REQUIRED HINTS "${CMAKE_CURRENT_SOURCE_DIR}/zephyr")
project(app LANGUAGES C)

target_sources(app PRIVATE
    "src/main.c"
)

target_include_directories(app PRIVATE
    "src"
)
```

## Kconfig
```
# All application Kconfig options can be defined here or included via other files.
# You can browse these options using the west targets menuconfig or guiconfig.

module = APP
module-str = APP
source "subsys/logging/Kconfig.template.log_config"

menu "Zephyr"
source "Kconfig.zephyr"
endmenu
```

## prj.conf
```kconfig
# Device Driver Configs

CONFIG_GPIO=y
CONFIG_LED=y

# Kernel Configs

CONFIG_INIT_STACKS=y

# Logging Configs

CONFIG_LOG=y
```

## src/main.c
```c
#include <app_version.h>
#include <zephyr/drivers/gpio.h>
#include <zephyr/kernel.h>
#include <zephyr/logging/log.h>

LOG_MODULE_REGISTER(app, CONFIG_APP_LOG_LEVEL);

static const struct gpio_dt_spec button = GPIO_DT_SPEC_GET(DT_ALIAS(sw0), gpios);
static struct gpio_callback button_cb;

static struct gpio_dt_spec led0 = GPIO_DT_SPEC_GET(DT_ALIAS(led0), gpios);

static uint32_t button_count = 0;
void button_pressed(const struct device* dev, struct gpio_callback* cb, uint32_t pins) {
    ARG_UNUSED(dev);
    ARG_UNUSED(cb);
    ARG_UNUSED(pins);

    button_count++;
    LOG_INF("button pressed %u times", button_count);
}

int32_t board_setup(void) {
    int32_t ret;

    if (!gpio_is_ready_dt(&button)) {
        LOG_ERR("Button init failed");
        return -ENODEV;
    }
    ret = gpio_pin_configure_dt(&button, GPIO_INPUT);
    if (ret < 0) {
        LOG_ERR("Button configure failed (%d)", ret);
        return ret;
    }
    ret = gpio_pin_interrupt_configure_dt(&button, GPIO_INT_EDGE_TO_ACTIVE);
    if (ret < 0) {
        LOG_ERR("Button irq configure failed (%d)", ret);
        return ret;
    }
    gpio_init_callback(&button_cb, button_pressed, BIT(button.pin));
    gpio_add_callback(button.port, &button_cb);

    if (!gpio_is_ready_dt(&led0)) {
        LOG_ERR("Led0 init failed");
        return -ENODEV;
    }
    ret = gpio_pin_configure_dt(&led0, GPIO_OUTPUT);
    if (ret < 0) {
        LOG_ERR("Led0 configure failed (%d)", ret);
        return ret;
    }

    return 0;
}

int32_t main(void) {
    int32_t ret = board_setup();
    if (ret < 0) { return ret; }

    LOG_INF("version: %s", STRINGIFY(APP_BUILD_VERSION));

    while (1) {
        /* Switch between LED always on, and blinking, depending on button press. */
        if ((button_count % 2) == 0) {
            gpio_pin_toggle_dt(&led0);
        } else {
            gpio_pin_set_dt(&led0, 1);
        }

        k_msleep(250);
    }

    return 0;
}
```
